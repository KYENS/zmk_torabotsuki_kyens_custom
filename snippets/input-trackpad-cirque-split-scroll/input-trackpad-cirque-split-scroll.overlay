/*
 * Scroll mode for a Cirque trackpad on the OTHER (peripheral, left) half.
 * Goes on the right-central build, together with input-split-listener.
 * The right trackball is not affected.
 *
 * While layer 1 is active (hold the right-thumb ENTER key, &lt 1 ENTER),
 * finger movement on the trackpad scrolls instead of moving the cursor.
 * Direction is "natural" (content follows the finger), like a laptop
 * touchpad.
 *
 * Tuning:
 *   layers                   which layer(s) turn on scrolling
 *   zip_scroll_scaler 1 3    scroll speed: output/input. Faster: 1 2, slower: 1 6
 *   Opposite direction       change Y_INVERT to X_INVERT
 *                            (that flips both scroll axes)
 */

#include <input/processors.dtsi>
#include <dt-bindings/zmk/input_transform.h>

&pointing_device_split_listener {
    trackpad_scroll {
        layers = <1>;
        input-processors = <&zip_xy_transform INPUT_TRANSFORM_Y_INVERT>,
                           <&zip_xy_to_scroll_mapper>,
                           <&zip_scroll_scaler 1 3>;
    };
};
