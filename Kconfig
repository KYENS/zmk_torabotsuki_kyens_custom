## Kconfig
```kconfig
rsource "drivers/cirque/Kconfig"

config ZMK_INPUT_PROCESSOR_TP_GESTURES
    bool "Trackpad gestures input processor (cursor, glide, taps, circular scroll)"
    default y
    depends on DT_HAS_ZMK_INPUT_PROCESSOR_TP_GESTURES_ENABLED
```

## config/west.yml
```yaml
manifest:
  remotes:
    - name: zmkfirmware
      url-base: https://github.com/zmkfirmware
    - name: sekigon-gonnoc
      url-base: https://github.com/sekigon-gonnoc
    - name: oleksandrmaslov
      url-base: https://github.com/oleksandrmaslov      
    - name: billyjacoby
      url-base: https://github.com/billyjacoby
  projects:
    - name: zmk
      remote: zmkfirmware
      revision: v0.3
      import: app/west.yml
    - name: zmk-pointing-acceleration
      remote: oleksandrmaslov
      revision: fixed
    - name: zmk-component-bmp-boost
      remote: sekigon-gonnoc
      import: west.yml
      revision: v0.2
    - name: zmk-feature-status-led
      remote: sekigon-gonnoc
      revision: main
    - name: zmk-driver-paw3222
      remote: sekigon-gonnoc
      revision: torabo-tsuki
    - name: zmk-driver-iqs7211e
      remote: sekigon-gonnoc
    - name: zmk-feature-cdc-acm-bootloader-trigger
      remote: sekigon-gonnoc
      revision: v0.2
    - name: zmk-feature-non-lipo-battery-management
      remote: sekigon-gonnoc
      revision: main
    - name: zmk-driver-kscan-4-direction-switch
      remote: sekigon-gonnoc
    - name: cirque-input-module
      remote: billyjacoby  # fork with absolute mode (finger position)
      revision: ba53fe81bad6690c5999b9e0c113988c1246b4d1  # pinned
  self:
    path: config
```

## dts/bindings/zmk,input-processor-tp-gestures.yaml
```yaml
description: |
  Trackpad gestures for a round Cirque pad in absolute mode: cursor
  (smoothed), glide, tap = left click, tap on an edge zone = right click,
  circular scroll by sliding around the edge. Must be first in the
  listener's input-processors. Pad coordinates are 0..1024 on both axes.

compatible: "zmk,input-processor-tp-gestures"

include: ip_zero_param.yaml

properties:
  invert-x:
    type: boolean
    description: Flip the pad's X axis so it grows to the user's right.
  invert-y:
    type: boolean
    description: Flip the pad's Y axis so it grows downward (toward the user).
  cursor-scale:
    type: int
    default: 60
    description: Cursor speed in percent (100 = 1 count per pad unit at 1.0x acceleration).
  rest-speed:
    type: int
    default: 60
    description: Finger speed (pad units/s) below which the cursor locks again (stops drifting).
  filter-min-cutoff-mhz:
    type: int
    default: 600
    description: 1-euro filter cutoff when moving slowly (mHz). Lower = smoother but laggier slow moves.
  filter-beta:
    type: int
    default: 8
    description: How quickly smoothing relaxes as you move faster. Higher = less lag on fast moves, more jitter.
  filter-speed-cutoff-mhz:
    type: int
    default: 1000
    description: Smoothing of the speed estimate used by the filter and acceleration (mHz).
  filter-max-lag:
    type: int
    default: 32
    description: The smoothed position never trails the finger by more than this (pad units), so fast starts aren't delayed.
  accel-min:
    type: int
    default: 650
    description: Cursor gain (per-mille) for very slow movement.
  accel-max:
    type: int
    default: 1800
    description: Cursor gain (per-mille) for fast movement.
  accel-mid-speed:
    type: int
    default: 1400
    description: Finger speed (pad units/s) where the gain is 1.0.
  accel-max-speed:
    type: int
    default: 7000
    description: Finger speed (pad units/s) where the gain reaches accel-max.
  rest-threshold:
    type: int
    default: 10
    description: Pad units the finger must move before the cursor follows. Raise if the cursor drifts while your finger rests.
  tap-ms:
    type: int
    default: 200
    description: Longest touch that still counts as a tap.
  tap-travel:
    type: int
    default: 24
    description: Farthest the finger may move from where it touched down (pad units) for a tap.
  right-click-clock:
    type: int
    default: 2
    description: A tap on the edge at this clock position (1-12, as you look at the pad) is a right click. 0 = off.
  right-click-width-deg:
    type: int
    default: 45
    description: Right-click zone covers clock position +/- this many degrees.
  right-click-reach-pct:
    type: int
    default: 65
    description: A right-click tap must be at least this % of the pad's reach from the centre.
  circle-reach-pct:
    type: int
    default: 75
    description: Circle scroll starts from touches at least this % of the pad's reach from the centre (the outer edge band).
  reach-init:
    type: int
    default: 420
    description: Assumed distance (pad units) from the centre to the pad's edge until the pad learns it from your touches. The real value is learned automatically.
  circle-start-deg:
    type: int
    default: 20
    description: How far (degrees) the finger must slide around the edge before scrolling starts.
  circle-units-per-turn:
    type: int
    default: 180
    description: Scroll amount for one full circle (15 = one wheel notch). 0 disables circular scroll.
  circle-invert:
    type: boolean
    description: Clockwise scrolls up instead of down.
  glide-decay:
    type: int
    default: 0
    description: Per-mille of glide speed kept every tick. Higher = longer glide. 0 = no glide.
  glide-min-speed:
    type: int
    default: 80
    description: Finger speed at lift (tenths of pad units per 10 ms) needed to glide.
  glide-stop-speed:
    type: int
    default: 4
    description: Glide stops below this speed (tenths of pad units per tick).
  glide-tick-ms:
    type: int
    default: 10
  glide-max-ms:
    type: int
    default: 1500
  lift-ms:
    type: int
    default: 50
    description: No position report for this long = finger lifted.
```
